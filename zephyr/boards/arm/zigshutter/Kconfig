## zephyr/boards/arm/zigshutter/Kconfig
```kconfig
# ZigShutter board configuration

# Copyright (c) 2024 Nicola Corna <nicola@corna.info>
# SPDX-License-Identifier: Apache-2.0

if BOARD_ZIGSHUTTER

config BOARD_ENABLE_DCDC
	bool "DCDC mode"
	select SOC_DCDC_NRF52X
	default y

config BOARD_ENABLE_DCDC_HV
	bool "High Voltage DCDC converter"
	select SOC_DCDC_NRF52X_HV
	default n

config BOARD_HAS_NRF5_BOOTLOADER
	bool "Board has nRF5 bootloader"
	default n
	help
	  If selected, applications are linked so that they can be loaded by Nordic
	  nRF5 bootloader.

config BOARD_SERIAL_BACKEND_CDC_ACM
	bool "USB CDC"
	default y

endif # BOARD_ZIGSHUTTER
```

## zephyr/boards/arm/zigshutter/Kconfig.board
```kconfig
# ZigShutter board configuration

# Copyright (c) 2024 Nicola Corna <nicola@corna.info>
# SPDX-License-Identifier: Apache-2.0

config BOARD_ZIGSHUTTER
	bool "ZIGSHUTTER NRF52840"
	depends on SOC_NRF52840_QIAA
```

## zephyr/boards/arm/zigshutter/Kconfig.defconfig
```kconfig
# Adafruit Feather nRF52840 Express board configuration

# Copyright (c) 2020 Tobias Svehagen
# SPDX-License-Identifier: Apache-2.0

if BOARD_ZIGSHUTTER

config BOARD
	default "zigshutter"

config BT_CTLR
	default BT

endif # BOARD_ZIGSHUTTER
```

## zephyr/boards/arm/zigshutter/zigshutter_defconfig
```kconfig
# SPDX-License-Identifier: Apache-2.0

CONFIG_SOC_SERIES_NRF52X=y
CONFIG_SOC_NRF52840_QIAA=y
CONFIG_BOARD_ZIGSHUTTER=y

# enable uart driver
CONFIG_SERIAL=y

# enable console
CONFIG_CONSOLE=y
#CONFIG_UART_CONSOLE=y

# Enable MPU
CONFIG_ARM_MPU=y

# Enable hardware stack protection
CONFIG_HW_STACK_PROTECTION=y

# enable GPIO
CONFIG_GPIO=y

# Clock control
CONFIG_CLOCK_CONTROL_NRF_K32SRC_RC=y

# Board Kconfig.defconfig enables USB CDC ACM and should disable USB remote
# wakeup by default. It needs to be disabled here, because the USB nrfx
# driver always overwrites option from Kconfig mentioned above with the
# imply from CONFIG_USB_NRFX.
CONFIG_USB_DEVICE_REMOTE_WAKEUP=n

# Adafruit bootloader support
CONFIG_BUILD_OUTPUT_UF2=y
CONFIG_ROM_START_OFFSET=0x1000
CONFIG_BOOTLOADER_BOSSA=n
```
